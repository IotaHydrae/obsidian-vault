/dts-v1/;
/plugin/;

/ {
	fragment@0 {
		target-path = "/";
		__overlay__ {
			i2c-dummy {
				compatible = "example,kb-dummy-i2c";
				#address-cells = <1>;
				#size-cells = <0>;
				status = "okay";

				device@42 {
					compatible = "example,kb-i2c-demo";
					reg = <0x42>;
				};
			};
		};
	};
};
